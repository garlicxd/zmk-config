#define ZMK_POINTING_DEFAULT_MOVE_VAL 1200
#define ZMK_POINTING_DEFAULT_SCRL_VAL 25

#include <input/processors.dtsi>
#include <zephyr/dt-bindings/input/input-event-codes.h>
#include <behaviors.dtsi>
#include <dt-bindings/zmk/bt.h>
#include <dt-bindings/zmk/keys.h>
#include <dt-bindings/zmk/outputs.h>
#include <dt-bindings/zmk/pointing.h>
#include <dt-bindings/zmk/rgb.h>

#define ZMK_HELPER_KEEP_NATIVE 0
#include "zmk-helpers/helper.h"

#include "eyelash_sofle_keydefs.dtsi"

#define L_DEF 0
#define L_GAME 1
#define L_MOU 2
#define L_OPT 3

&mmv_input_listener { input-processors = <&zip_xy_scaler 2 1>; };
&msc_input_listener { input-processors = <&zip_scroll_scaler 2 1>; };

&msc {
    acceleration-exponent = <1>;
    time-to-max-speed-ms = <100>;
    delay-ms = <0>;
};

&mmv {
    time-to-max-speed-ms = <500>;
    acceleration-exponent = <1>;
    trigger-period-ms = <16>;
};

#define QUICK_TAP_MS 175
&sk {
    release-after-ms = <900>;
    quick-release;
};
&sl { 
    ignore-modifiers;
};
&lt {
    flavor = "balanced";
    tapping-term-ms = <200>;
    quick-tap-ms = <QUICK_TAP_MS>;
};
&mt {
    flavor = "tap-preferred";
    tapping-term-ms = <220>;
    quick-tap-ms = <220>;
    hold-trigger-key-positions = <0>;
};
&caps_word {
    continue-list = <UNDERSCORE MINUS>;
};
&key_repeat {
    usage-pages = <HID_USAGE_KEY HID_USAGE_CONSUMER>;
};

&soft_off { hold-time-ms = <2000>; };

// -------------------------------------------------------------------------
// DEFINITIONS
// -------------------------------------------------------------------------

#define LEFT_CHARS B Y O U Q C I E A Z
#define LEFT_SYMBS SLASH BACKSLASH MINUS UNDERSCORE COMMA ASTERISK DOT DOUBLE_QUOTES CARET DOLLAR AMPERSAND SEMICOLON HASH AT_SIGN QUESTION PIPE EXCLAMATION PERCENT EQUAL ESCAPE
#define RIGHT_CHARS J L D W V K H T N S X M G P F
#define RIGHT_SYMBS TILDE COLON LEFT_BRACKET LESS_THAN SINGLE_QUOTE GRAVE PLUS LEFT_PARENTHESIS LEFT_BRACE RIGHT_BRACKET GREATER_THAN RIGHT_PARENTHESIS RIGHT_BRACE
#define NUM_CHARS N0 N1 N2 N3 N4 N5 N6 N7 N8 N9

#define ADAPTIVE_RESET 1200
#define COMBO_TERM_FAST 30
#define COMBO_TERM_SLOW 250
#define COMBO_IDLE_FAST 30
#define COMBO_IDLE_SLOW 150

// -------------------------------------------------------------------------
// BEHAVIORS
// -------------------------------------------------------------------------

#define SHIFT_MORPH(NAME, BINDING1, BINDING2) \
    ZMK_MOD_MORPH(NAME, bindings = <BINDING1>, <BINDING2>; mods = <(MOD_LSFT|MOD_RSFT)>;)

#define MAKE_HRM(NAME, HOLD, TAP, TRIGGER_POS)                          \
    ZMK_HOLD_TAP( NAME, bindings = <HOLD>, <TAP>; flavor = "balanced";          \
                    tapping-term-ms = <200>; quick-tap-ms = <QUICK_TAP_MS>;     \
                    require-prior-idle-ms = <150>;                              \
                    hold-trigger-key-positions = <TRIGGER_POS>;                 \
                    hold-trigger-on-release;                                    \
                )
MAKE_HRM(hmt, &mo, &kp, KEYS_R KEYS_L KEYS_T)

MAKE_HRM(hml, &kp, &kp, KEYS_R KEYS_T)
MAKE_HRM(hrr, &mo, &kp, KEYS_R KEYS_T)

MAKE_HRM(hmr, &kp, &kp, KEYS_L KEYS_T)
MAKE_HRM(hlr, &mo, &kp, KEYS_L KEYS_T)



#define RUNE_L &hm_rune_l LSHIFT 0
    ZMK_MOD_MORPH(rune_l, bindings = <&sk LSHIFT>, <&arc_left>; mods = <(MOD_LSFT|MOD_RSFT)>;)
    MAKE_HRM(hm_rune_l, &kp, &rune_l, KEYS_R KEYS_L KEYS_T_R) 
    ZMK_ADAPTIVE_KEY(arc_left, bindings = <&key_repeat>;
        spc_sft {bindings = <&sk LSHIFT>; trigger-keys = <SPACE>; max-prior-idle-ms = <ADAPTIVE_RESET>;};
    )

#define RUNE_R &hm_rune_r RSHIFT 0
    ZMK_MOD_MORPH(rune_r, bindings = <&sk RSHIFT>, <&arc_right>; mods = <(MOD_LSFT|MOD_RSFT)>;)
    MAKE_HRM(hm_rune_r, &kp, &rune_r, KEYS_L KEYS_R KEYS_T_L) 
    ZMK_ADAPTIVE_KEY(arc_right, bindings = <&key_repeat>;
        spc_sft {bindings = <&sk RSHIFT>; trigger-keys = <SPACE>; max-prior-idle-ms = <ADAPTIVE_RESET>;};
    )

#define STICKY_L &sticky_l LSHIFT LSHIFT
    MAKE_HRM(sticky_l, &sk, &kp, KEYS_R KEYS_T_R)

#define STICKY_R &sticky_r RSHIFT RSHIFT
    MAKE_HRM(sticky_r, &sk, &kp, KEYS_L KEYS_T_L)

// -------------------------------------------------------------------------
// MAGIC KEYS & SPACE REPEAT
// -------------------------------------------------------------------------

// --- L_MAGIC (Key Above / Upward Cycle) ---
// Sequence: Z->A, A->Q, Q->Z ...
#define L_MAGIC &mt LGUI &l_magic
    ZMK_ADAPTIVE_KEY(l_magic, bindings = <&none>; 
        za {bindings = <&kp A>; trigger-keys = <Z>; max-prior-idle-ms = <ADAPTIVE_RESET>;};
        aq {bindings = <&kp Q>; trigger-keys = <A>; max-prior-idle-ms = <ADAPTIVE_RESET>;};
        qz {bindings = <&kp Z>; trigger-keys = <Q>; max-prior-idle-ms = <ADAPTIVE_RESET>;};

        xs {bindings = <&kp S>; trigger-keys = <X>; max-prior-idle-ms = <ADAPTIVE_RESET>;};
        sw {bindings = <&kp W>; trigger-keys = <S>; max-prior-idle-ms = <ADAPTIVE_RESET>;};
        wx {bindings = <&kp X>; trigger-keys = <W>; max-prior-idle-ms = <ADAPTIVE_RESET>;};

        cd {bindings = <&kp D>; trigger-keys = <C>; max-prior-idle-ms = <ADAPTIVE_RESET>;};
        de {bindings = <&kp E>; trigger-keys = <D>; max-prior-idle-ms = <ADAPTIVE_RESET>;};
        ec {bindings = <&kp C>; trigger-keys = <E>; max-prior-idle-ms = <ADAPTIVE_RESET>;};

        vf {bindings = <&kp F>; trigger-keys = <V>; max-prior-idle-ms = <ADAPTIVE_RESET>;};
        fr {bindings = <&kp R>; trigger-keys = <F>; max-prior-idle-ms = <ADAPTIVE_RESET>;};
        rv {bindings = <&kp V>; trigger-keys = <R>; max-prior-idle-ms = <ADAPTIVE_RESET>;};

        bg {bindings = <&kp G>; trigger-keys = <B>; max-prior-idle-ms = <ADAPTIVE_RESET>;};
        gt {bindings = <&kp T>; trigger-keys = <G>; max-prior-idle-ms = <ADAPTIVE_RESET>;};
        tb {bindings = <&kp B>; trigger-keys = <T>; max-prior-idle-ms = <ADAPTIVE_RESET>;};

        nh {bindings = <&kp H>; trigger-keys = <N>; max-prior-idle-ms = <ADAPTIVE_RESET>;};
        hy {bindings = <&kp Y>; trigger-keys = <H>; max-prior-idle-ms = <ADAPTIVE_RESET>;};
        yn {bindings = <&kp N>; trigger-keys = <Y>; max-prior-idle-ms = <ADAPTIVE_RESET>;};

        mj {bindings = <&kp J>; trigger-keys = <M>; max-prior-idle-ms = <ADAPTIVE_RESET>;};
        ju {bindings = <&kp U>; trigger-keys = <J>; max-prior-idle-ms = <ADAPTIVE_RESET>;};
        um {bindings = <&kp M>; trigger-keys = <U>; max-prior-idle-ms = <ADAPTIVE_RESET>;};

        ck {bindings = <&kp K>; trigger-keys = <COMMA>; max-prior-idle-ms = <ADAPTIVE_RESET>;};
        ki {bindings = <&kp I>; trigger-keys = <K>; max-prior-idle-ms = <ADAPTIVE_RESET>;};
        ic {bindings = <&kp COMMA>; trigger-keys = <I>; max-prior-idle-ms = <ADAPTIVE_RESET>;};

        dl {bindings = <&kp L>; trigger-keys = <DOT>; max-prior-idle-ms = <ADAPTIVE_RESET>;};
        lo {bindings = <&kp O>; trigger-keys = <L>; max-prior-idle-ms = <ADAPTIVE_RESET>;};
        od {bindings = <&kp DOT>; trigger-keys = <O>; max-prior-idle-ms = <ADAPTIVE_RESET>;};

        fs {bindings = <&kp SEMI>; trigger-keys = <FSLH>; max-prior-idle-ms = <ADAPTIVE_RESET>;};
        sp {bindings = <&kp P>; trigger-keys = <SEMI>; max-prior-idle-ms = <ADAPTIVE_RESET>;};
        pf {bindings = <&kp FSLH>; trigger-keys = <P>; max-prior-idle-ms = <ADAPTIVE_RESET>;};
    )

// --- R_MAGIC (Key Below / Downward Cycle) ---
// Sequence: Q->A, A->Z, Z->Q ...
#define R_MAGIC &mt RGUI &r_magic
    ZMK_ADAPTIVE_KEY(r_magic, bindings = <&none>; 
        qa {bindings = <&kp A>; trigger-keys = <Q>; max-prior-idle-ms = <ADAPTIVE_RESET>;};
        az {bindings = <&kp Z>; trigger-keys = <A>; max-prior-idle-ms = <ADAPTIVE_RESET>;};
        zq {bindings = <&kp Q>; trigger-keys = <Z>; max-prior-idle-ms = <ADAPTIVE_RESET>;};

        ws {bindings = <&kp S>; trigger-keys = <W>; max-prior-idle-ms = <ADAPTIVE_RESET>;};
        sx {bindings = <&kp X>; trigger-keys = <S>; max-prior-idle-ms = <ADAPTIVE_RESET>;};
        xw {bindings = <&kp W>; trigger-keys = <X>; max-prior-idle-ms = <ADAPTIVE_RESET>;};

        ed {bindings = <&kp D>; trigger-keys = <E>; max-prior-idle-ms = <ADAPTIVE_RESET>;};
        dc {bindings = <&kp C>; trigger-keys = <D>; max-prior-idle-ms = <ADAPTIVE_RESET>;};
        ce {bindings = <&kp E>; trigger-keys = <C>; max-prior-idle-ms = <ADAPTIVE_RESET>;};

        rf {bindings = <&kp F>; trigger-keys = <R>; max-prior-idle-ms = <ADAPTIVE_RESET>;};
        fv {bindings = <&kp V>; trigger-keys = <F>; max-prior-idle-ms = <ADAPTIVE_RESET>;};
        vr {bindings = <&kp R>; trigger-keys = <V>; max-prior-idle-ms = <ADAPTIVE_RESET>;};

        tg {bindings = <&kp G>; trigger-keys = <T>; max-prior-idle-ms = <ADAPTIVE_RESET>;};
        gb {bindings = <&kp B>; trigger-keys = <G>; max-prior-idle-ms = <ADAPTIVE_RESET>;};
        bt {bindings = <&kp T>; trigger-keys = <B>; max-prior-idle-ms = <ADAPTIVE_RESET>;};

        yh {bindings = <&kp H>; trigger-keys = <Y>; max-prior-idle-ms = <ADAPTIVE_RESET>;};
        hn {bindings = <&kp N>; trigger-keys = <H>; max-prior-idle-ms = <ADAPTIVE_RESET>;};
        ny {bindings = <&kp Y>; trigger-keys = <N>; max-prior-idle-ms = <ADAPTIVE_RESET>;};

        uj {bindings = <&kp J>; trigger-keys = <U>; max-prior-idle-ms = <ADAPTIVE_RESET>;};
        jm {bindings = <&kp M>; trigger-keys = <J>; max-prior-idle-ms = <ADAPTIVE_RESET>;};
        mu {bindings = <&kp U>; trigger-keys = <M>; max-prior-idle-ms = <ADAPTIVE_RESET>;};

        ik {bindings = <&kp K>; trigger-keys = <I>; max-prior-idle-ms = <ADAPTIVE_RESET>;};
        kc {bindings = <&kp COMMA>; trigger-keys = <K>; max-prior-idle-ms = <ADAPTIVE_RESET>;};
        ci {bindings = <&kp I>; trigger-keys = <COMMA>; max-prior-idle-ms = <ADAPTIVE_RESET>;};

        ol {bindings = <&kp L>; trigger-keys = <O>; max-prior-idle-ms = <ADAPTIVE_RESET>;};
        ld {bindings = <&kp DOT>; trigger-keys = <L>; max-prior-idle-ms = <ADAPTIVE_RESET>;};
        do {bindings = <&kp O>; trigger-keys = <DOT>; max-prior-idle-ms = <ADAPTIVE_RESET>;};

        ps {bindings = <&kp SEMI>; trigger-keys = <P>; max-prior-idle-ms = <ADAPTIVE_RESET>;};
        sf {bindings = <&kp FSLH>; trigger-keys = <SEMI>; max-prior-idle-ms = <ADAPTIVE_RESET>;};
        fp {bindings = <&kp P>; trigger-keys = <FSLH>; max-prior-idle-ms = <ADAPTIVE_RESET>;};
    )

// --- L_SPACEREP (Left Space) ---
#define L_SPACEREP &l_spacerep
    ZMK_ADAPTIVE_KEY(l_spacerep, bindings = <&kp SPACE>;
        // If last key was RIGHT side -> Repeat
        rep { 
            bindings = <&key_repeat>; 
            trigger-keys = <
                Y U I O P 
                H J K L SEMI APOS
                N M COMMA DOT FSLH 
                RSHIFT RCTRL RALT RGUI LBKT RBKT
            >; 
            max-prior-idle-ms = <ADAPTIVE_RESET>; 
        };
        spc_sft {bindings = <&sk LSHIFT>; trigger-keys = <SPACE>; max-prior-idle-ms = <ADAPTIVE_RESET>;};
    )

// --- R_SPACEREP (Right Space) ---
#define R_SPACEREP &r_spacerep
    ZMK_ADAPTIVE_KEY(r_spacerep, bindings = <&kp SPACE>;
        // If last key was LEFT side -> Repeat
        rep { 
            bindings = <&key_repeat>; 
            trigger-keys = <
                Q W E R T 
                A S D F G 
                Z X C V B 
                LSHIFT LCTRL LALT LGUI
            >; 
            max-prior-idle-ms = <ADAPTIVE_RESET>; 
        };
        spc_sft {bindings = <&sk LSHIFT>; trigger-keys = <SPACE>; max-prior-idle-ms = <ADAPTIVE_RESET>;};
    )

// -------------------------------------------------------------------------
// COMBOS
// -------------------------------------------------------------------------

ZMK_COMBO(f12_combo, &kp F12, LN5 LT5, L_DEF, COMBO_TERM_SLOW, COMBO_IDLE_FAST)
ZMK_COMBO(f1_combo,  &kp F1,  LN4 LT4, L_DEF, COMBO_TERM_SLOW, COMBO_IDLE_FAST)
ZMK_COMBO(f2_combo,  &kp F2,  LN3 LT4, L_DEF, COMBO_TERM_SLOW, COMBO_IDLE_FAST)
ZMK_COMBO(f3_combo,  &kp F3,  LN2 LT3, L_DEF, COMBO_TERM_SLOW, COMBO_IDLE_FAST)
ZMK_COMBO(f4_combo,  &kp F4,  LN1 LT2, L_DEF, COMBO_TERM_SLOW, COMBO_IDLE_FAST)
ZMK_COMBO(f5_combo,  &kp F5,  LN0 LT1, L_DEF, COMBO_TERM_SLOW, COMBO_IDLE_FAST)
ZMK_COMBO(f6_combo,  &kp F6,  RN0 RT0, L_DEF, COMBO_TERM_SLOW, COMBO_IDLE_FAST)
ZMK_COMBO(f7_combo,  &kp F7,  RN1 RT1, L_DEF, COMBO_TERM_SLOW, COMBO_IDLE_FAST)
ZMK_COMBO(f8_combo,  &kp F8,  RN2 RT2, L_DEF, COMBO_TERM_SLOW, COMBO_IDLE_FAST)
ZMK_COMBO(f9_combo,  &kp F9,  RN3 RT3, L_DEF, COMBO_TERM_SLOW, COMBO_IDLE_FAST)
ZMK_COMBO(f10_combo, &kp F10, RN4 RT4, L_DEF, COMBO_TERM_SLOW, COMBO_IDLE_FAST)
ZMK_COMBO(f11_combo, &kp F11, RN5 RT5, L_DEF, COMBO_TERM_SLOW, COMBO_IDLE_FAST)

ZMK_COMBO(caps_combo,  &kp CAPS,        LM4 LT4, L_DEF,         COMBO_TERM_SLOW, COMBO_IDLE_FAST)
// ZMK_COMBO(esc_combo,   &kp ESC,         LM1 LT1, L_DEF,         COMBO_TERM_SLOW, COMBO_IDLE_FAST)
// ZMK_COMBO(enter_combo, &kp ENTER,       LM2 LT2, L_DEF,         COMBO_TERM_SLOW, COMBO_IDLE_FAST)
// ZMK_COMBO(tab_combo,   &kp TAB,         LM1 LT1, L_DEF,         COMBO_TERM_SLOW, COMBO_IDLE_FAST)

ZMK_COMBO(pscrn_combo, &kp PSCRN,       LM5 LB5, L_DEF L_GAME,  COMBO_TERM_SLOW, COMBO_IDLE_FAST)
ZMK_COMBO(redo_combo,  &kp LC(Y),       LB4 LM4, L_DEF L_GAME,  COMBO_TERM_SLOW, COMBO_IDLE_FAST)
ZMK_COMBO(cut_combo,   &kp LC(X),       LB3 LM3, L_DEF L_GAME,  COMBO_TERM_SLOW, COMBO_IDLE_FAST)
ZMK_COMBO(capsw_combo, &caps_word,      LB1 LM1, L_DEF,         COMBO_TERM_SLOW, COMBO_IDLE_FAST)

ZMK_COMBO(left_combo,  &kp LEFT_ARROW,  RT0 RM0, L_DEF L_GAME,  COMBO_TERM_SLOW, COMBO_IDLE_FAST)
ZMK_COMBO(down_combo,  &kp DOWN_ARROW,  RT1 RM1, L_DEF L_GAME,  COMBO_TERM_SLOW, COMBO_IDLE_FAST)
ZMK_COMBO(up_combo,    &kp UP_ARROW,    RT2 RM2, L_DEF L_GAME,  COMBO_TERM_SLOW, COMBO_IDLE_FAST)
ZMK_COMBO(right_combo, &kp RIGHT_ARROW, RT3 RM3, L_DEF L_GAME,  COMBO_TERM_SLOW, COMBO_IDLE_FAST)

ZMK_COMBO(home_combo,  &kp HOME,        RM0 RB0, L_DEF L_GAME,  COMBO_TERM_SLOW, COMBO_IDLE_FAST)
ZMK_COMBO(pgdn_combo,  &kp PGDN,        RM1 RB1, L_DEF L_GAME,  COMBO_TERM_SLOW, COMBO_IDLE_FAST)
ZMK_COMBO(pgup_combo,  &kp PGUP,        RM2 RB2, L_DEF L_GAME,  COMBO_TERM_SLOW, COMBO_IDLE_FAST)
ZMK_COMBO(end_combo,   &kp END,         RM3 RB3, L_DEF L_GAME,  COMBO_TERM_SLOW, COMBO_IDLE_FAST)


/ {
    scroll_encoder: scroll_encoder { compatible = "zmk,behavior-sensor-rotate"; #sensor-binding-cells = <0>;
        bindings = <&msc SCRL_DOWN>, <&msc SCRL_UP>; tap-ms = <100>;
    };

    behaviors {
    };

    combos {
        compatible = "zmk,combos";

        softoff {
            bindings = <&soft_off>;
            key-positions = <14 28 40>;
        };
    };

    keymap { 
        compatible = "zmk,keymap";

        L_DEF { sensor-bindings = <&scroll_encoder>; display-name = "Default Layer"; bindings = < 
//╭─────────────┬─────────────┬─────────────┬─────────────┬─────────────┬─────────────╮          ╭─────────────┬─────────────┬─────────────┬─────────────┬─────────────┬─────────────╮
    &kp DEL       &kp N1        &kp N2        &kp N3        &kp N4        &kp N5      &kp UP_ARROW &kp N6        &kp N7        &kp N8        &kp N9        &kp N0        &kp BSPC
//├─────────────┼─────────────┼─────────────┼─────────────┼─────────────┼─────────────┤          ├─────────────┼─────────────┼─────────────┼─────────────┼─────────────┼─────────────┤
    &kp EQUAL     &kp Q         &kp W         &kp E         &kp R         &kp T      &kp DOWN_ARROW &kp Y        &kp U         &kp I         &kp O         &kp P         &kp APOS
//├─────────────┼─────────────┼─────────────┼─────────────┼─────────────┼─────────────┤          ├─────────────┼─────────────┼─────────────┼─────────────┼─────────────┼─────────────┤
    &kp MINUS     &hml LALT A   &hml LCTL S   &hml LGUI D   &hml LSFT F   &kp G      &kp LEFT_ARROW &kp H        &hmr RSFT J  &hmr RGUI K     &hmr RCTL L  &hmr RALT SEMI &kp LBKT
//├─────────────┼─────────────┼─────────────┼─────────────┼─────────────┼─────────────┤          ├─────────────┼─────────────┼─────────────┼─────────────┼─────────────┼─────────────┤
    &kp ESC       &kp Z         &kp X         &kp C         &kp V         &kp B      &kp RIGHT_ARROW &kp N        &kp M        &kp COMMA     &kp DOT       &kp FSLH      &kp RBKT
//╰─────────────┼─────────────┼─────────────┼─────────────┼─────────────┼─────────────┤          ├─────────────┼─────────────┼─────────────┼─────────────┼─────────────┼─────────────╯
    &kp C_MUTE    &mo L_OPT     &kp A         &kp GRAVE     &kp TAB       &kp SPACE     &kp ENTER  &kp SPACE     &kp ENTER     &kp BSLH      &kp A         &kp A
//              ╰─────────────┴─────────────┴─────────────┴─────────────┴─────────────╯          ╰─────────────┴─────────────┴─────────────┴─────────────┴─────────────╯
            >;
        };

        L_GAME { sensor-bindings = <&scroll_encoder>; display-name = "GAME"; bindings = < 
//╭─────────────┬─────────────┬─────────────┬─────────────┬─────────────┬─────────────╮          ╭─────────────┬─────────────┬─────────────┬─────────────┬─────────────┬─────────────╮
    &kp DEL       &kp N1        &kp N2        &kp N3        &kp N4        &kp N5      &kp UP_ARROW &kp N6        &kp N7        &kp N8        &kp N9        &kp N0        &kp BSPC
//├─────────────┼─────────────┼─────────────┼─────────────┼─────────────┼─────────────┤          ├─────────────┼─────────────┼─────────────┼─────────────┼─────────────┼─────────────┤
    &kp TAB       &kp Q         &kp W         &kp E         &kp R         &kp T      &kp DOWN_ARROW &kp Y        &kp U         &kp I         &kp O         &kp P         &kp APOS
//├─────────────┼─────────────┼─────────────┼─────────────┼─────────────┼─────────────┤          ├─────────────┼─────────────┼─────────────┼─────────────┼─────────────┼─────────────┤
    &kp LCTL      &kp A         &kp S         &kp D         &kp F         &kp G      &kp LEFT_ARROW &kp H        &kp J         &kp K         &kp L         &kp SEMI      &kp LBKT
//├─────────────┼─────────────┼─────────────┼─────────────┼─────────────┼─────────────┤          ├─────────────┼─────────────┼─────────────┼─────────────┼─────────────┼─────────────┤
    &kp LSFT      &kp Z         &kp X         &kp C         &kp V         &kp B      &kp RIGHT_ARROW &kp N       &kp M         &kp COMMA     &kp DOT       &kp FSLH      &kp RBKT
//╰─────────────┼─────────────┼─────────────┼─────────────┼─────────────┼─────────────┤          ├─────────────┼─────────────┼─────────────┼─────────────┼─────────────┼─────────────╯
    &kp C_MUTE    &trans        &trans        &kp ESC       &kp TAB       &kp SPACE    &kp ENTER   &kp SPACE     &kp ENTER     &trans        &trans        &trans
//              ╰─────────────┴─────────────┴─────────────┴─────────────┴─────────────╯          ╰─────────────┴─────────────┴─────────────┴─────────────┴─────────────╯
            >;
        };

        L_MOU {
            bindings = <
//╭─────────────┬─────────────┬─────────────┬─────────────┬─────────────┬─────────────╮        ╭─────────────┬─────────────┬─────────────┬─────────────┬─────────────┬─────────────╮
    &trans        &trans        &trans        &trans        &trans        &trans        &trans   &trans        &trans        &trans        &trans        &trans        &trans
//├─────────────┼─────────────┼─────────────┼─────────────┼─────────────┼─────────────┤        ├─────────────┼─────────────┼─────────────┼─────────────┼─────────────┼─────────────┤
    &trans        &trans        &trans        &trans        &trans        &trans        &trans   &mkp MCLK     &mkp LCLK     &mkp RCLK     &mkp MB4      &mkp MB5      &trans
//├─────────────┼─────────────┼─────────────┼─────────────┼─────────────┼─────────────┤        ├─────────────┼─────────────┼─────────────┼─────────────┼─────────────┼─────────────┤
    &trans        &trans        &trans        &trans        &trans        &trans        &trans   &mmv MOVE_LEFT &mmv MOVE_DOWN &mmv MOVE_UP &mmv MOVE_RIGHT &trans     &trans
//├─────────────┼─────────────┼─────────────┼─────────────┼─────────────┼─────────────┤        ├─────────────┼─────────────┼─────────────┼─────────────┼─────────────┼─────────────┤
    &trans        &trans        &trans        &trans        &trans        &trans        &trans   &trans        &trans        &trans        &trans        &trans        &trans
//╰─────────────┼─────────────┼─────────────┼─────────────┼─────────────┼─────────────┤        ├─────────────┼─────────────┼─────────────┼─────────────┼─────────────┼─────────────╯
    &trans        &trans        &trans        &trans        &trans        &trans        &trans   &trans        &trans        &trans        &trans        &trans        &trans
//              ╰─────────────┴─────────────┴─────────────┴─────────────┴─────────────╯        ╰─────────────┴─────────────┴─────────────┴─────────────┴─────────────╯
            >;

            display-name = "Mouse Layer";
            sensor-bindings = <&inc_dec_kp C_VOLUME_UP C_VOL_DN>;
        };

        L_OPT { sensor-bindings = <&scroll_encoder>; display-name = "OPTIONS"; bindings = <
//╭─────────────┬─────────────┬─────────────┬─────────────┬─────────────┬─────────────╮        ╭─────────────┬─────────────┬─────────────┬─────────────┬─────────────┬─────────────╮
    &trans        &trans        &trans        &trans        &trans        &trans        &trans   &trans        &trans        &trans        &trans        &trans        &trans
//├─────────────┼─────────────┼─────────────┼─────────────┼─────────────┼─────────────┤        ├─────────────┼─────────────┼─────────────┼─────────────┼─────────────┼─────────────┤
    &tog L_GAME   &trans        &trans        &trans        &trans        &trans        &trans   &trans        &trans        &trans        &trans        &trans        &trans
//├─────────────┼─────────────┼─────────────┼─────────────┼─────────────┼─────────────┤        ├─────────────┼─────────────┼─────────────┼─────────────┼─────────────┼─────────────┤
    &trans        &bt BT_SEL 3  &bt BT_SEL 2  &bt BT_SEL 1  &bt BT_SEL 0  &sys_reset    &trans   &sys_reset    &trans        &trans        &trans        &trans        &trans
//├─────────────┼─────────────┼─────────────┼─────────────┼─────────────┼─────────────┤        ├─────────────┼─────────────┼─────────────┼─────────────┼─────────────┼─────────────┤
    &trans       &bt BT_CLR_ALL &bt BT_CLR    &out OUT_USB  &out OUT_BLE  &bootloader   &trans   &bootloader   &trans        &trans        &trans        &trans        &trans
//╰─────────────┼─────────────┼─────────────┼─────────────┼─────────────┼─────────────┤        ├─────────────┼─────────────┼─────────────┼─────────────┼─────────────┼─────────────╯
    &trans        &trans        &trans        &trans        &trans        &trans        &trans   &trans        &trans        &trans        &trans        &trans        &trans
//              ╰─────────────┴─────────────┴─────────────┴─────────────┴─────────────╯        ╰─────────────┴─────────────┴─────────────┴─────────────┴─────────────╯
        >;};


    };
};